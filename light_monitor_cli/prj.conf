## CMakeLists.txt
```
#
# Copyright (c) 2020 Nordic Semiconductor ASA
#
# SPDX-License-Identifier: LicenseRef-Nordic-5-Clause
#
cmake_minimum_required(VERSION 3.20.0)

find_package(Zephyr REQUIRED HINTS $ENV{ZEPHYR_BASE})
project(NONE)

# NORDIC SDK APP START
target_sources(app PRIVATE
	src/main.c
	src/model_handler.c
	src/light_monitor_cli.c)
target_include_directories(app PRIVATE include)
# NORDIC SDK APP END
```

## Kconfig
```
#
# Copyright (c) 2020 Nordic Semiconductor
#
# SPDX-License-Identifier: LicenseRef-Nordic-5-Clause
#

source "Kconfig.zephyr"

menu "Nordic Bluetooth mesh light monitor Client sample"

config BT_MESH_LIGHT_MONITOR_MESSAGE_LENGTH
	int "Max length of the message to be sent over mesh"
	default 90
	range 0 255
	help
	  Impacts on memory size occupied by the buffer of a message to be
	  published. This does not include null terminator. The message must also
	  fit into the application SDU. Adjust BT_MESH_TX_SEG_MAX and
	  BT_MESH_RX_SEG_MAX to be able to receive the longest messages.

config BT_MESH_LIGHT_MONITOR_CACHE_SIZE
	int "Presence cache size"
	default 10
	range 0 32767
	help
	  Presence cache stores previously received presence of chat clients.
	  Recommended to be as big as number of chat clients in the mesh network.

endmenu

module = BT_MESH_LIGHT_MONITOR_CLI
module-str = BT Mesh Light Monitor client model
source "${ZEPHYR_BASE}/subsys/logging/Kconfig.template.log_config"
```

## prj.conf
```kconfig
#
# Copyright (c) 2020 Nordic Semiconductor ASA
#
# SPDX-License-Identifier: LicenseRef-Nordic-5-Clause
#
CONFIG_NCS_SAMPLES_DEFAULTS=y

# Deffered logging helps improve LPN power consumption
# when friendship is established.
CONFIG_LOG_MODE_DEFERRED=y

# General configuration
CONFIG_SYSTEM_WORKQUEUE_STACK_SIZE=2048
CONFIG_FLASH=y
CONFIG_FLASH_MAP=y
CONFIG_NVS=y
CONFIG_SETTINGS=y
CONFIG_HWINFO=y
CONFIG_DK_LIBRARY=y
CONFIG_PM_SINGLE_IMAGE=y
CONFIG_PM_PARTITION_SIZE_SETTINGS_STORAGE=0x8000
CONFIG_SOC_FLASH_NRF_PARTIAL_ERASE=y

# Bluetooth configuration
CONFIG_BT=y
CONFIG_BT_COMPANY_ID=0x0059
CONFIG_BT_DEVICE_NAME="Mesh Light Monitor Client"
CONFIG_BT_L2CAP_TX_MTU=69
CONFIG_BT_L2CAP_TX_BUF_COUNT=8
CONFIG_BT_CTLR_DATA_LENGTH_MAX=37
CONFIG_BT_BUF_ACL_TX_SIZE=37
CONFIG_BT_OBSERVER=y
CONFIG_BT_PERIPHERAL=y
CONFIG_BT_SETTINGS=y

# Disable unused Bluetooth features
CONFIG_BT_CTLR_DUP_FILTER_LEN=0
CONFIG_BT_CTLR_LE_ENC=n
CONFIG_BT_PHY_UPDATE=n
CONFIG_BT_CTLR_CHAN_SEL_2=n
CONFIG_BT_CTLR_MIN_USED_CHAN=n
CONFIG_BT_CTLR_PRIVACY=n

# Bluetooth Mesh configuration
CONFIG_BT_MESH=y
CONFIG_BT_MESH_RELAY=y
CONFIG_BT_MESH_FRIEND=y
CONFIG_BT_MESH_ADV_BUF_COUNT=13
CONFIG_BT_MESH_RX_SEG_MAX=10
CONFIG_BT_MESH_TX_SEG_MAX=10
CONFIG_BT_MESH_GATT_PROXY=y
CONFIG_BT_MESH_PB_GATT=y
CONFIG_BT_MESH_DK_PROV=y

# Enable Bluetooth mesh models debug logs
CONFIG_BT_MESH_LOG_LEVEL_DBG=y


# ADC config
CONFIG_NRFX_SAADC=y
CONFIG_ADC=y
CONFIG_NRFX_GPIOTE=y

# Enable Shell module and use UART as a backend
CONFIG_SHELL=y
CONFIG_SHELL_BACKEND_SERIAL=y

CONFIG_BT_MESH_MODEL_EXTENSIONS=y
```

## include/light_monitor_cli.h
```c
/*
 * Copyright (c) 2020 Nordic Semiconductor ASA
 *
 * SPDX-License-Identifier: LicenseRef-Nordic-5-Clause
 */

/**
 * @file
 * @defgroup bt_mesh_light_monitor
 * @{
 * @brief API for the Bluetooth Mesh Chat Client model.
 */

#ifndef BT_MESH_LIGHT_MONITOR_CLI_H__
#define BT_MESH_LIGHT_MONITOR_CLI_H__

#include <zephyr/bluetooth/mesh.h>
#include <bluetooth/mesh/model_types.h>
#include <bluetooth/mesh/sensor_cli.h>

#ifdef __cplusplus
extern "C" {
#endif

#define BT_MESH_LIGHT_MONITOR_VENDOR_COMPANY_ID 0x0059
#define BT_MESH_LIGHT_MONITOR_VENDOR_MODEL_ID 0x000C

#define BT_MESH_LIGHT_MONITOR_VENDOR_SETUP_MODEL_ID 0x000D

#define GET_STATUS_OPCODE BT_MESH_MODEL_OP_3(0x01, BT_MESH_LIGHT_MONITOR_VENDOR_COMPANY_ID)
#define TEST_ACK_OPCODE BT_MESH_MODEL_OP_3(0x02, BT_MESH_LIGHT_MONITOR_VENDOR_COMPANY_ID)
#define TEST_RESULT_OPCODE BT_MESH_MODEL_OP_3(0x03, BT_MESH_LIGHT_MONITOR_VENDOR_COMPANY_ID)
#define UPDATE_STATUS_OPCODE BT_MESH_MODEL_OP_3(0x04, BT_MESH_LIGHT_MONITOR_VENDOR_COMPANY_ID)
#define TEST_START_OPCODE BT_MESH_MODEL_OP_3(0x05, BT_MESH_LIGHT_MONITOR_VENDOR_COMPANY_ID)
#define RESULT_LOG_OPCODE BT_MESH_MODEL_OP_3(0x06, BT_MESH_LIGHT_MONITOR_VENDOR_COMPANY_ID)
#define GET_LOG_OPCODE BT_MESH_MODEL_OP_3(0x07, BT_MESH_LIGHT_MONITOR_VENDOR_COMPANY_ID)
#define GET_ACK_OPCODE BT_MESH_MODEL_OP_3(0x08, BT_MESH_LIGHT_MONITOR_VENDOR_COMPANY_ID)
#define GET_START_OPCODE BT_MESH_MODEL_OP_3(0x09, BT_MESH_LIGHT_MONITOR_VENDOR_COMPANY_ID)
#define GET_RESULT_OPCODE BT_MESH_MODEL_OP_3(0x0A, BT_MESH_LIGHT_MONITOR_VENDOR_COMPANY_ID)
#define GET_TEST_START_OPCODE BT_MESH_MODEL_OP_3(0x0B, BT_MESH_LIGHT_MONITOR_VENDOR_COMPANY_ID)

#define CALIBRATE_OPCODE BT_MESH_MODEL_OP_3(0x0C, BT_MESH_LIGHT_MONITOR_VENDOR_COMPANY_ID)
#define CALIBRATE_OK_OPCODE BT_MESH_MODEL_OP_3(0x0D, BT_MESH_LIGHT_MONITOR_VENDOR_COMPANY_ID)

#define BT_MESH_LIGHT_MONITOR_MSG_MINLEN_MESSAGE 1
#define BT_MESH_LIGHT_MONITOR_MSG_MAXLEN_MESSAGE                                                   \
	(CONFIG_BT_MESH_LIGHT_MONITOR_MESSAGE_LENGTH + 1) /* + \0 */
#define BT_MESH_LIGHT_MONITOR_MSG_LEN_MESSAGE_REPLY 0
#define BT_MESH_LIGHT_MONITOR_MSG_LEN_PRESENCE 1
#define BT_MESH_LIGHT_MONITOR_MSG_LEN_PRESENCE_GET 0

#define GET_STATUS_LEN 0
#define TEST_ACK_LEN 0
#define TEST_RESULT_LEN 1
#define STATUS_UPDATE_LEN 2
#define TEST_START_LEN 1
#define RESULT_LOG_LEN 5
#define GET_LOG_LEN 1
#define GET_START_LEN 0
#define GET_RESULT_LEN 0
#define CALIBRATE_LEN 0

#define SLEEP_TIME_MS 1000
#define RECEIVE_BUFF_SIZE 2000
#define RECEIVE_TIMEOUT 100

/*test*/
/* Forward declaration of the Bluetooth Mesh Light Monitor Client model context. */
struct bt_mesh_light_monitor;

#define BT_MESH_MODEL_LIGHT_MONITOR(_monitor)                                                      \
	BT_MESH_MODEL_VND_CB(BT_MESH_LIGHT_MONITOR_VENDOR_COMPANY_ID,                              \
			     BT_MESH_LIGHT_MONITOR_VENDOR_MODEL_ID, _bt_mesh_light_monitor_op,     \
			     &(_monitor)->pub,                                                     \
			     BT_MESH_MODEL_USER_DATA(struct bt_mesh_light_monitor, _monitor),      \
			     &_bt_mesh_light_monitor_cb)										   


/** Bluetooth Mesh Light Monitor handlers. */
struct bt_light_monitor_handlers {
	/** @brief Called after the monitor has been provisioned, or after all
     * mesh data has been loaded from persistent storage.
     *
     * @param[in] monitor Light Monitor instance that has been started.
     */
	void (*const start)(struct bt_mesh_light_monitor *monitor);

	/** @brief Handler for an update message.
     *
     * @param[in] monitor Light Monitor instance that received the update message.
     * @param[in] ctx Context of the incoming message.
     * @param[in] msg Received update message.nRF Connect SDK
     */
	void (*const update)(struct bt_mesh_light_monitor *monitor, struct bt_mesh_msg_ctx *ctx,
			     uint16_t msg);

	/** @brief Handler for a result.
     *
     * @param[in] monitor Light Monitor instance that received the result.
     * @param[in] ctx Context of the incoming message.
     * @param[in] result Pointer to the received result.
     */
	void (*const result)(struct bt_mesh_light_monitor *monitor, struct bt_mesh_msg_ctx *ctx,
			     bool *result);

	/** @brief Handler for a result log entry.
     *
     * @param[in] monitor Light Monitor instance that received the result log.
     * @param[in] ctx Context of the incoming message.
     * @param[in] result The result of given test.
     * @param[in] time_stamp The timestamp of when the test was started.
     */
	int (*const result_log)(struct bt_mesh_light_monitor *monitor, struct bt_mesh_msg_ctx *ctx,
				 bool result, uint32_t time_stamp);

	/** @brief Handler for a test acknowledgement message.
     *
     * @param[in] monitor Light Monitor instance that received the test acknowledgement message.
     * @param[in] ctx Context of the incoming message.
     */
	int (*const test_ack)(struct bt_mesh_light_monitor *monitor, struct bt_mesh_msg_ctx *ctx);

	/** @brief Handler for a get_start message.
     *
     * @param[in] monitor Light Monitor instance that received the get start message.
     * @param[in] ctx Context of the incoming message.
     */
	int (*const get_start)(struct bt_mesh_light_monitor *monitor, struct bt_mesh_msg_ctx *ctx);


	/** @brief Handler for a calibrate_ok message.
     *
     * @param[in] monitor Light Monitor instance that received the get start message.
     * @param[in] ctx Context of the incoming message.
     */
	void (*const calibrate_ok)(struct bt_mesh_light_monitor *monitor, struct bt_mesh_msg_ctx *ctx);
};

struct bt_mesh_light_monitor {
	/** Access model pointer. */
	struct bt_mesh_model *model;
	/** Publish parameters. */
	struct bt_mesh_model_pub pub;
	/** Publication message. */
	struct net_buf_simple pub_msg;

	struct bt_mesh_sensor_cli sensor_cli;
	/** Publication message buffer. */
	uint16_t buf[BT_MESH_MODEL_BUF_LEN(UPDATE_STATUS_OPCODE,
					   BT_MESH_LIGHT_MONITOR_MSG_MAXLEN_MESSAGE)];
	/** Handler function structure. */
	const struct bt_light_monitor_handlers *handlers;
};

struct bt_mesh_light_monitor_setup {
	/** Access model pointer. */
	struct bt_mesh_model *model;
	/** Publish parameters. */
	struct bt_mesh_model_pub pub;
	/** Publication message. */
	struct net_buf_simple pub_msg;
	/** Publication message buffer. */
	uint16_t buf[BT_MESH_MODEL_BUF_LEN(UPDATE_STATUS_OPCODE,
					   BT_MESH_LIGHT_MONITOR_MSG_MAXLEN_MESSAGE)];
	/** Handler function structure. */
	const struct bt_light_monitor_setup_handlers *handlers;
};

int set_light_test_start(struct bt_mesh_light_monitor *monitor, uint16_t test_duration,
			 uint32_t time_stamp);
int get_status(struct bt_mesh_light_monitor *monitor);
int get_test_result(struct bt_mesh_light_monitor *monitor, uint16_t addr);
int set_light_test_start_single(struct bt_mesh_light_monitor *monitor, struct bt_mesh_msg_ctx *ctx,
				uint16_t test_duration, uint32_t timestamp);
int get_test_ack(struct bt_mesh_light_monitor *monitor, uint16_t addr);
int get_result_log(struct bt_mesh_light_monitor *monitor, uint16_t addr);
int calibrate_node(struct bt_mesh_light_monitor *monitor, uint16_t addr);

/** @cond INTERNAL_HIDDEN */
extern const struct bt_mesh_model_op _bt_mesh_light_monitor_op[];
extern const struct bt_mesh_model_cb _bt_mesh_light_monitor_cb;
extern const struct bt_mesh_model_op _bt_mesh_light_monitor_setup_op[];
extern const struct bt_mesh_model_cb _bt_mesh_light_monitor_setup_cb;
/** @endcond */

#ifdef __cplusplus
}
#endif

#endif /* BT_MESH_LIGHT_MONITOR_H__ */

/** @} */
```

## include/model_handler.h
```c
/*
 * Copyright (c) 2020 Nordic Semiconductor ASA
 *
 * SPDX-License-Identifier: LicenseRef-Nordic-5-Clause
 */

/**
 * @file
 * @brief Model handler
 */

#ifndef MODEL_HANDLER_H__
#define MODEL_HANDLER_H__

#include <zephyr/bluetooth/mesh.h>

#ifdef __cplusplus
extern "C" {
#endif

/*A standard test length in seconds 7200*/
#define TEST_DURATION 7200
#define TEST_DURATION_TESTING 60
#define TEST_TIME_STAMP 1111111111

struct NodesList {
	uint16_t nodes[512];
	uint16_t len;
};

struct UartInput {
	uint8_t code;
	uint32_t value;
	uint16_t duration;
};

const struct bt_mesh_comp *model_handler_init(void);

#ifdef __cplusplus
}
#endif

#endif /* MODEL_HANDLER_H__ */
```

## src/light_monitor_cli.c
```c
/*
 * Copyright (c) 2019 Nordic Semiconductor ASA
 *
 * SPDX-License-Identifier: LicenseRef-Nordic-5-Clause
 */

#include <zephyr/bluetooth/mesh.h>
#include "light_monitor_cli.h"
#include "mesh/net.h"
#include <string.h>
#include <zephyr/logging/log.h>
#include <bluetooth/mesh/sensor_cli.h>

static int handle_test_ack(struct bt_mesh_model *model, struct bt_mesh_msg_ctx *ctx,
			   struct net_buf_simple *buf)
{
	struct bt_mesh_light_monitor *monitor = model->user_data;

	if (monitor->handlers->test_ack) {
		monitor->handlers->test_ack(monitor, ctx);
	}
	return 0;
}

static int handle_test_result(struct bt_mesh_model *model, struct bt_mesh_msg_ctx *ctx,
			      struct net_buf_simple *buf)
{
	struct bt_mesh_light_monitor *monitor = model->user_data;
	bool *result;

	result = net_buf_simple_pull_mem(buf, buf->len);
	if (monitor->handlers->result) {
		monitor->handlers->result(monitor, ctx, result);
	}
	return 0;
}

static int handle_test_log(struct bt_mesh_model *model, struct bt_mesh_msg_ctx *ctx,
			    struct net_buf_simple *buf)
{
	struct bt_mesh_light_monitor *monitor = model->user_data;
	bool *result;
	uint32_t time_stamp;
	time_stamp = net_buf_simple_remove_le32(buf);
	result = net_buf_simple_pull_mem(buf, 1);
	if (monitor->handlers->result_log) {
		monitor->handlers->result_log(monitor, ctx, *result, time_stamp);
	}
	return 0;
}

static int handle_message_status_update(struct bt_mesh_model *model, struct bt_mesh_msg_ctx *ctx,
					struct net_buf_simple *buf)
{
	struct bt_mesh_light_monitor *monitor = model->user_data;
	uint16_t msg;

	msg = net_buf_simple_pull_le16(buf);
	if (monitor->handlers->update) {
		monitor->handlers->update(monitor, ctx, msg);
	}
	return 0;
}

static int handle_test_start_get(struct bt_mesh_model *model, struct bt_mesh_msg_ctx *ctx,
				 struct net_buf_simple *buf)
{
	struct bt_mesh_light_monitor *monitor = model->user_data;
	if (monitor->handlers->get_start) {
		monitor->handlers->get_start(monitor, ctx);
	}

	return 0;
}

static int handle_calibrate_ok(struct bt_mesh_model *model, struct bt_mesh_msg_ctx *ctx,
				 struct net_buf_simple *buf)
{
	struct bt_mesh_light_monitor *monitor = model->user_data;
	if (monitor->handlers->calibrate_ok) {
		monitor->handlers->calibrate_ok(monitor, ctx);
	}
	return 0;
}

const struct bt_mesh_model_op _bt_mesh_light_monitor_op[] = {
	{ TEST_ACK_OPCODE, TEST_ACK_LEN, handle_test_ack },
	{ TEST_RESULT_OPCODE, TEST_RESULT_LEN, handle_test_result },
	{ UPDATE_STATUS_OPCODE, STATUS_UPDATE_LEN, handle_message_status_update },
	{ RESULT_LOG_OPCODE, RESULT_LOG_LEN, handle_test_log },
	{ GET_START_OPCODE, GET_START_LEN, handle_test_start_get },
	{ CALIBRATE_OK_OPCODE, CALIBRATE_LEN, handle_calibrate_ok },
	BT_MESH_MODEL_OP_END,
};
uint16_t msg;
bool result_msg;

int set_light_test_start(struct bt_mesh_light_monitor *monitor, uint16_t test_duration,
			 uint32_t timestamp)
{
	struct net_buf_simple *buf = monitor->model->pub->msg;

	bt_mesh_model_msg_init(buf, TEST_START_OPCODE);
	net_buf_simple_add_le16(buf, test_duration);
	net_buf_simple_add_le32(buf, timestamp);

	return bt_mesh_model_publish(monitor->model);
}

int get_test_result(struct bt_mesh_light_monitor *monitor, uint16_t addr)
{
	struct bt_mesh_msg_ctx ctx = {
		.addr = addr,
		.app_idx = monitor->model->keys[0],
		.send_ttl = BT_MESH_TTL_DEFAULT,
		.send_rel = false,
	};
	BT_MESH_MODEL_BUF_DEFINE(buf, GET_RESULT_OPCODE,
				 BT_MESH_LIGHT_MONITOR_MSG_LEN_MESSAGE_REPLY);
	bt_mesh_model_msg_init(&buf, GET_RESULT_OPCODE);

	return bt_mesh_model_send(monitor->model, &ctx, &buf, NULL, NULL);
}

int set_light_test_start_single(struct bt_mesh_light_monitor *monitor, struct bt_mesh_msg_ctx *ctx,
				uint16_t test_duration, uint32_t timestamp)
{
	BT_MESH_MODEL_BUF_DEFINE(buf, TEST_START_OPCODE, 6);

	bt_mesh_model_msg_init(&buf, TEST_START_OPCODE);
	net_buf_simple_add_le16(&buf, test_duration);
	net_buf_simple_add_le32(&buf, timestamp);

	(void)bt_mesh_model_send(monitor->model, ctx, &buf, NULL, NULL);

	return 0;
}

int get_test_ack(struct bt_mesh_light_monitor *monitor, uint16_t addr)
{
	struct bt_mesh_msg_ctx ctx = {
		.addr = addr,
		.app_idx = monitor->model->keys[0],
		.send_ttl = BT_MESH_TTL_DEFAULT,
		.send_rel = false,
	};
	BT_MESH_MODEL_BUF_DEFINE(buf, GET_ACK_OPCODE, BT_MESH_LIGHT_MONITOR_MSG_LEN_MESSAGE_REPLY);
	bt_mesh_model_msg_init(&buf, GET_ACK_OPCODE);
	return bt_mesh_model_send(monitor->model, &ctx, &buf, NULL, NULL);
}

int calibrate_node(struct bt_mesh_light_monitor *monitor, uint16_t addr)
{
	struct bt_mesh_msg_ctx ctx = {
		.addr = addr,
		.app_idx = monitor->model->keys[0],
		.send_ttl = BT_MESH_TTL_DEFAULT,
		.send_rel = false,
	};
	BT_MESH_MODEL_BUF_DEFINE(buf, CALIBRATE_OPCODE, CALIBRATE_LEN);
	bt_mesh_model_msg_init(&buf, CALIBRATE_OPCODE);
	return bt_mesh_model_send(monitor->model, &ctx, &buf, NULL, NULL);
}

int get_status(struct bt_mesh_light_monitor *monitor)
{
	struct net_buf_simple *buf = monitor->model->pub->msg;

	bt_mesh_model_msg_init(buf, GET_STATUS_OPCODE);

	return bt_mesh_model_publish(monitor->model);
}

int get_result_log(struct bt_mesh_light_monitor *monitor, uint16_t addr)
{
	struct bt_mesh_msg_ctx ctx = {
		.addr = addr, .app_idx = monitor->model->keys[0], .send_ttl = BT_MESH_TTL_DEFAULT,
		/*.send_rel = false, */

	};
	BT_MESH_MODEL_BUF_DEFINE(buf, GET_LOG_OPCODE, 2);
	bt_mesh_model_msg_init(&buf, GET_LOG_OPCODE);

	return bt_mesh_model_send(monitor->model, &ctx, &buf, NULL, NULL);
}

static int bt_mesh_light_monitor_update_handler(struct bt_mesh_model *model)
{
	return 0;
}

static int bt_mesh_light_monitor_init(struct bt_mesh_model *model)
{
	int err;
	struct bt_mesh_light_monitor *monitor = model->user_data;
	monitor->model = model;
	
	err = bt_mesh_model_extend(model, monitor->sensor_cli.model);

	net_buf_simple_init_with_data(&monitor->pub_msg, monitor->buf, sizeof(monitor->buf));
	monitor->pub.msg = &monitor->pub_msg;
	monitor->pub.update = bt_mesh_light_monitor_update_handler;

	return 0;
}

const struct bt_mesh_model_cb _bt_mesh_light_monitor_cb = { .init = bt_mesh_light_monitor_init }; /*
 * Copyright (c) 2019 Nordic Semiconductor ASA
 *
 * SPDX-License-Identifier: LicenseRef-Nordic-5-Clause
 */
```

## src/model_handler.c
```c
/*
 * Copyright (c) 2019 Nordic Semiconductor ASA
 *
 * SPDX-License-Identifier: LicenseRef-Nordic-5-Clause
 */

#include <stdio.h>

#include <zephyr/bluetooth/bluetooth.h>
#include <zephyr/bluetooth/mesh.h>
#include <bluetooth/mesh/models.h>
#include <dk_buttons_and_leds.h>

#include <zephyr/drivers/uart.h>

#include "light_monitor_cli.h"
#include "model_handler.h"
#include <zephyr/drivers/gpio.h>
#include <zephyr/device.h>
#include <zephyr/devicetree.h>
#include <inttypes.h>
#include <stddef.h>
#include <stdint.h>
#include <zephyr/drivers/adc.h>
#include <zephyr/kernel.h>
#include <zephyr/sys/printk.h>
#include <zephyr/sys/util.h>
#include <zephyr/drivers/gpio.h>
/*#include <power/reboot.h>*/

#include <zephyr/shell/shell.h>
#include <zephyr/shell/shell_uart.h>

#include <zephyr/logging/log.h>

#if !DT_NODE_EXISTS(DT_PATH(zephyr_user)) || !DT_NODE_HAS_PROP(DT_PATH(zephyr_user), io_channels)
#error "No suitable devicetree overlay specified"
#endif

#define DT_SPEC_AND_COMMA(node_id, prop, idx) ADC_DT_SPEC_GET_BY_IDX(node_id, idx),

#define THRESHOLD_VALUE 3500
#define DIGITAL_PIN 29

const struct device *uart = DEVICE_DT_GET(DT_NODELABEL(uart0));
static const struct device *gpio_dev;
static struct bt_mesh_light_monitor monitor;
bool nodes_list_reading_active = false;
struct NodesList active_nodes;
bool ack_list[1024] = { 0 };
bool res_list[1024] = { 0 };
bool test_running = false;
int err;

static const struct shell *monitor_shell;
/******************************************************************************/
/*************************** Health server setup ******************************/
/******************************************************************************/
/* Set up a repeating delayed work to blink the DK's LEDs when attention is
 * requested.
 */
static struct k_work_delayable attention_blink_work;
static bool attention;

static void attention_blink(struct k_work *work)
{
	static int idx;
	const uint8_t pattern[] = {
		BIT(0) | BIT(1),
		BIT(1) | BIT(2),
		BIT(2) | BIT(3),
		BIT(3) | BIT(0),
	};

	if (attention) {
		dk_set_leds(pattern[idx++ % ARRAY_SIZE(pattern)]);
		k_work_reschedule(&attention_blink_work, K_MSEC(30));
	} else {
		dk_set_leds(DK_NO_LEDS_MSK);
	}
}

static void attention_on(struct bt_mesh_model *mod)
{
	attention = true;
	k_work_reschedule(&attention_blink_work, K_NO_WAIT);
}

static void attention_off(struct bt_mesh_model *mod)
{
	/* Will stop rescheduling blink timer */
	attention = false;
}

static const struct bt_mesh_health_srv_cb health_srv_cb = {
	.attn_on = attention_on,
	.attn_off = attention_off,
};

static struct bt_mesh_health_srv health_srv = {
	.cb = &health_srv_cb,
};

BT_MESH_HEALTH_PUB_DEFINE(health_pub, 0);
/******************************************************************************/
/**************************** peripheral setup ********************************/
/******************************************************************************/
/*The uart is configured and logic for the test is handled here*/
uint32_t this_test_timestamp;
uint16_t this_test_duration;
uint16_t ack_idx;

static void result_checker();
static void ack_checker();
struct k_timer ack_timer;
struct k_work ack_work;
K_WORK_DEFINE(ack_work, ack_checker);
struct k_timer result_timer;
struct k_work result_work;
K_WORK_DEFINE(result_work, result_checker);

static void set_array_to_false(bool array[])
{
	for (int x = 0; x < active_nodes.len; x++) {
		array[active_nodes.nodes[x]] = false;
	}
}

static void ack_work_handler(struct k_timer *timer)
{
	k_work_submit(&ack_work);
}

static struct k_work_delayable sched_ack_work;

static void sched_ack_work_cb(struct k_work *work)
{
	ack_checker();
}

static void ack_checker()
{
	if (active_nodes.nodes[ack_idx] == 0) {
		shell_print(monitor_shell, "Empty nodes list \n");
	} else if (ack_list[active_nodes.nodes[ack_idx]] == false) {
		get_test_ack(&monitor, active_nodes.nodes[ack_idx]);
		shell_print(monitor_shell, "Get test ack for node %d\n", active_nodes.nodes[ack_idx]);
	}

	if (ack_idx >= active_nodes.len) {
		ack_idx = 0;
		set_array_to_false(ack_list);
	} else {
		ack_idx++;
		k_work_reschedule(&sched_ack_work, K_MSEC(500));
	}
}

static void result_work_handler(struct k_timer *timer)
{
	k_work_submit(&result_work);
}

static struct k_work_delayable sched_res_work;

static void sched_res_work_cb(struct k_work *work)
{
	result_checker();
}

static void result_checker()
{
	if (active_nodes.nodes[ack_idx] == 0) {
		shell_print(monitor_shell, "Empty nodes list\n");
	} else if (res_list[active_nodes.nodes[ack_idx]] == false) {
		get_test_result(&monitor, active_nodes.nodes[ack_idx]);
		shell_print(monitor_shell, "Get test result for node %d\n", active_nodes.nodes[ack_idx]);
	}
	if (ack_idx >= active_nodes.len) {
		ack_idx = 0;
		test_running = false;
		set_array_to_false(res_list);
	} else {
		ack_idx++;
		k_work_reschedule(&sched_res_work, K_MSEC(1000));
	}
}

static int test_start(uint16_t duration, uint32_t time)
{
	ack_idx = 0;
	test_running = true;
	set_light_test_start(&monitor, duration, time);
	k_timer_init(&ack_timer, ack_work_handler, NULL);
	k_timer_start(&ack_timer, K_SECONDS(2), K_NO_WAIT);
	k_timer_init(&result_timer, result_work_handler, NULL);
	k_timer_start(&result_timer, K_SECONDS(duration + 5), K_NO_WAIT);
	this_test_timestamp = time;
	this_test_duration = duration;
	return 0;
}

static void button_handler_cb(uint32_t pressed, uint32_t changed)
{
	if (!bt_mesh_is_provisioned()) {
		return;
	}
	if (pressed == BIT(0)) {
		shell_print(monitor_shell, "button 1 was pressed\n");
	}
	if (pressed == BIT(1)) {
		shell_print(monitor_shell, "button 2 was pressed\n");
		err = get_status(&monitor);
	}
	if (pressed == BIT(2)) {
		gpio_pin_set(gpio_dev, DIGITAL_PIN, 0);
		shell_print(monitor_shell, "button 3 was pressed\n");
	}
	if (pressed == BIT(3)) {
		gpio_pin_set(gpio_dev, DIGITAL_PIN, 1);
		shell_print(monitor_shell, "button 4 was pressed\n");
	}

	if (err < 0) {
		shell_print(monitor_shell, "err is %d \n", err);
	}
}

/******************************************************************************/
/*************************** monitor model setup ******************************/
/******************************************************************************/
/*All handling of monitor model cb  are done here*/

static void handle_start(struct bt_mesh_light_monitor *monitor)
{
	shell_print(monitor_shell, "Started \n");
}

static void handle_status_update(struct bt_mesh_light_monitor *monitor, struct bt_mesh_msg_ctx *ctx,
				 uint16_t msg)
{
	shell_print(monitor_shell, "status %d %d", ctx->addr, msg);
}

static void handle_result(struct bt_mesh_light_monitor *monitor, struct bt_mesh_msg_ctx *ctx,
			  bool *result)
{
	shell_print(monitor_shell, "result %d %s", ctx->addr,  *result ? "passed" : "failed");
	res_list[ctx->addr] = true;

}

static int handle_test_ack(struct bt_mesh_light_monitor *monitor, struct bt_mesh_msg_ctx *ctx)
{
	shell_print(monitor_shell, "acking %d waiting", ctx->addr);

	ack_list[ctx->addr] = true;
	return 0;
}

static int handle_get_start(struct bt_mesh_light_monitor *monitor, struct bt_mesh_msg_ctx *ctx)
{
	set_light_test_start_single(monitor, ctx, this_test_duration, this_test_timestamp);
	return 0;
}

static int handle_result_log(struct bt_mesh_light_monitor *monitor, struct bt_mesh_msg_ctx *ctx,
			      bool result, uint32_t time_stamp)
{
	shell_print(monitor_shell, "logged %d %u %d \n", result, time_stamp, ctx->addr);

	return 0;
}

static void handle_series_entry(struct bt_mesh_sensor_cli *cli, struct bt_mesh_msg_ctx *ctx,
				const struct bt_mesh_sensor_type *sensor, uint8_t index,
				uint8_t count, const struct bt_mesh_sensor_series_entry *entry)
{
	shell_print(monitor_shell, "status %d", ctx->addr);
}

static void handle_sensor_data(struct bt_mesh_sensor_cli *cli, struct bt_mesh_msg_ctx *ctx,
			       const struct bt_mesh_sensor_type *sensor,
			       const struct sensor_value *value)
{
	uint16_t msg;
	msg = value->val1;
	shell_print(monitor_shell, "status %d %d", ctx->addr, msg);
}

static void handle_calibrate_ok(struct bt_mesh_light_monitor *monitor, struct bt_mesh_msg_ctx *ctx)
{
	shell_print(monitor_shell, "calibrate is ok for node %d \n", ctx->addr);
}

static const struct bt_light_monitor_handlers monitor_handlers = {
	.start = handle_start,
	.update = handle_status_update,
	.result = handle_result,
	.test_ack = handle_test_ack,
	.result_log = handle_result_log,
	.get_start = handle_get_start,
	.calibrate_ok = handle_calibrate_ok

};

static const struct bt_mesh_sensor_cli_handlers sensor_handlers = {
	.series_entry = handle_series_entry,
	.data = handle_sensor_data,
};

static struct bt_mesh_light_monitor monitor = {
	.handlers = &monitor_handlers,
	.sensor_cli.cb = &sensor_handlers,
};

static struct bt_mesh_elem elements[] = {
	BT_MESH_ELEM(1,
		     BT_MESH_MODEL_LIST(BT_MESH_MODEL_CFG_SRV,
					BT_MESH_MODEL_HEALTH_SRV(&health_srv, &health_pub)),
		     BT_MESH_MODEL_LIST(BT_MESH_MODEL_LIGHT_MONITOR(&monitor))),
};

static const struct bt_mesh_comp comp = {
	.cid = CONFIG_BT_COMPANY_ID,
	.elem = elements,
	.elem_count = ARRAY_SIZE(elements),
};

static int cmd_test_start(const struct shell *shell, size_t argc, char *argv[])
{

		uint32_t msg_value;
		uint16_t msg_duration;

		msg_duration = strtol(argv[1], NULL, 0);
		msg_value = strtol(argv[2], NULL, 0);

		if (test_running == false) {
			test_start(msg_duration, msg_value);
		} else {
			shell_print(monitor_shell, "Test is already running \n");
		}

	return 0;
}

static int cmd_get_status(const struct shell *shell, size_t argc, char *argv[])
{
	get_status(&monitor);

	return 0;
}

static int cmd_get_result_log(const struct shell *shell, size_t argc, char *argv[])
{
	uint32_t msg_value;

	msg_value = strtol(argv[1], NULL, 0);
	get_result_log(&monitor, msg_value);

	return 0;
}

static int cmd_get_test_ack(const struct shell *shell, size_t argc, char *argv[])
{
	uint32_t msg_value;


	msg_value = strtol(argv[1], NULL, 0);
	get_test_ack(&monitor, msg_value);

	return 0;
}

static int cmd_nodes_list(const struct shell *shell, size_t argc, char *argv[])
{

	for (int i = 0; i < active_nodes.len; i++) {
		uint16_t nodeValue = active_nodes.nodes[i];
		shell_print(monitor_shell, "nodeok %d\n", nodeValue);
	}

	return 0;
}

static int cmd_portok(const struct shell *shell, size_t argc, char *argv[])
{
	shell_print(monitor_shell,"PORTOK\n");

	return 0;
}

static int cmd_reset_nodes(const struct shell *shell, size_t argc, char *argv[])
{
	active_nodes.nodes[0] = 0;
	active_nodes.len = 0;

	return 0;
}

static int cmd_add_first_node(const struct shell *shell, size_t argc, char *argv[])
{
	uint32_t msg_value;

	msg_value = strtol(argv[1], NULL, 0);
	active_nodes.nodes[active_nodes.len] = msg_value;

	return 0;
}

static int cmd_add_node(const struct shell *shell, size_t argc, char *argv[])
{
	uint32_t msg_value;

	msg_value = strtol(argv[1], NULL, 0);
	active_nodes.len++;
	active_nodes.nodes[active_nodes.len] = msg_value;
	return 0;
}


static int cmd_calibrate_node(const struct shell *shell, size_t argc, char *argv[])
{
	uint32_t msg_value;

	msg_value = strtol(argv[1], NULL, 0);
	calibrate_node(&monitor, msg_value);

	return 0;
}

SHELL_STATIC_SUBCMD_SET_CREATE(monitor_cmds,
	SHELL_CMD_ARG(start, NULL, "Start test", cmd_test_start, 3, 0),
	SHELL_CMD_ARG(status, NULL, "Get status", cmd_get_status, 0, 0),
	SHELL_CMD_ARG(log, NULL, "get log", cmd_get_result_log, 2, 0),
	SHELL_CMD_ARG(ack, NULL, "get ack from selected node. Input is node addr", cmd_get_test_ack, 2, 0),
	SHELL_CMD_ARG(nodeslist, NULL, "Get a list of the nodes registered on the card", cmd_nodes_list, 0, 0),
	SHELL_CMD_ARG(portok, NULL, "Getting the right port helper", cmd_portok, 0, 0),
	SHELL_CMD_ARG(reset_nodes, NULL, "Resets the list of nodes back to 0", cmd_reset_nodes, 0, 0),
	SHELL_CMD_ARG(add_first_node, NULL, "Add the first node to a blank list", cmd_add_first_node, 2, 0),
	SHELL_CMD_ARG(add_node, NULL, "Add a node to a not empty list", cmd_add_node, 2, 0),
	SHELL_CMD_ARG(calibrate, NULL, "Calibrate the sensor on the node", cmd_calibrate_node, 2, 0),
	SHELL_SUBCMD_SET_END
);

static int cmd_monitor(const struct shell *shell, size_t argc, char **argv)
{
	if (argc == 1) {
		shell_help(shell);
		/* shell returns 1 when help is printed */
		return 1;
	}

	shell_error(shell, "%s unknown parameter: %s", argv[0], argv[1]);

	return -EINVAL;
}

SHELL_CMD_ARG_REGISTER(monitor, &monitor_cmds, "Bluetooth Mesh Chat Client commands",
		       cmd_monitor, 1, 1);

const struct bt_mesh_comp *model_handler_init(void)
{
	//k_work_init_delayable(&send_msg_work, send_msg_work_cb);
	k_work_init_delayable(&attention_blink_work, attention_blink);
	k_work_init_delayable(&sched_ack_work, sched_ack_work_cb);
	k_work_init_delayable(&sched_res_work, sched_res_work_cb);

	monitor_shell = shell_backend_uart_get_ptr();
	shell_print(monitor_shell, ">>> Shell test <<<");
	/* uart_init(); */
	static struct button_handler button_handler = {
		.cb = button_handler_cb,
	};
	dk_button_handler_add(&button_handler);
	return &comp;
}
```
